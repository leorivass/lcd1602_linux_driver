/dts-v1/;
/plugin/;
/ {
	compatible = "brcm,bcm2837";
	fragment@0 {
		target = <&i2c1>;
		__overlay__ {
			#address-cells = <1>;
			#size-cells = <0>;

			lcd1602: lcd1602@27 {
				compatible = "generic,lcd1602";
				reg = <0x27>;
				status = "okay";
			};
		};
	};
};